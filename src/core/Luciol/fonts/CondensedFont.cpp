#include <Arduino.h>
#include "CondensedFont.h"


CondensedFont::CondensedFont() {}


uint8_t CondensedFont::getCharWidth(char c) {
    if (c == ' ') return 3;
    uint8_t ci = getCharIndex(c);
    if (ci >= 59) {
        return 3;
    }
    uint8_t* ch = chars[ci];
    if (! ch) {
        return 3;
    }
    return ch[5];
}


uint8_t CondensedFont::getCharIndex(char c) {
    // Special chars
    switch (c) {
        case 95:
            return 59;
        case 176:
            return 58;
    }
    
    // lowercase -> UPPERCASE
    if (c >= 97 && c <= 122) {
        c -= 32;
    }
    
    c -= 33; // Skip non-printable chars		
    
    return c;
}


uint8_t* CondensedFont::getChar(char c) {
    uint8_t index = getCharIndex(c);
    if (index < CondensedFontCharCount) {
        return chars[index];
    }
    return NULL;
}


uint8_t CondensedFont::getHeight() {
    return 5;
}


bool CondensedFont::handlesDiacritics() {
    return false;
}


uint8_t CondensedFont::chars[CondensedFontCharCount][6] = {
    // 33 (0)
    
    { 0x01, 0x01, 0x01, 0x00, 0x01, 1 }, // !
    { 0x05, 0x05, 0x00, 0x00, 0x00, 3 }, // "
    { 0x0A, 0x1F, 0x0A, 0x1F, 0x0A, 5 }, // #
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    { 0x01, 0x02, 0x04, 0x08, 0x10, 5 }, // /
    
    // 48 (15)
    
    // Digits
    { 0x07, 0x05, 0x05, 0x05, 0x07, 3 }, // 0
    { 0x02, 0x06, 0x02, 0x02, 0x07, 3 }, // 1
    { 0x07, 0x01, 0x07, 0x04, 0x07, 3 }, // 2
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    { 0x0E, 0x15, 0x17, 0x10, 0x0E, 5 }, // @

    // Capital letters A-Z
    // 65 (32)
    { 0x07, 0x05, 0x07, 0x05, 0x05, 3 }, // A
    { 0x0E,	0x09, 0x0E, 0x09, 0x0E, 4 }, // B
    { 0x07,	0x04, 0x04,	0x04, 0x07, 3 }, // C
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    { 0x07, 0x01, 0x02, 0x04, 0x07, 3 }, // Z

    // Special chars
    // (58)
    { 0x07, 0x05, 0x07, 0x00, 0x00, 3 }, // °
    { 0x00, 0x00, 0x00, 0x00, 0x0F, 4 }  // _
    
    // l1    l2    l3    l4    l5   ^ width
};