#include <Arduino.h>
#include "CondensedFont.h"


CondensedFont::CondensedFont() {}


uint8_t CondensedFont::getCharWidth(char c) {
    return 5;
}


uint8_t CondensedFont::getCharIndex(char ch) {
    if (ch >= 48 && ch <= 57) {
        ch -= 48;
    } else if (ch >= 97 && ch <= 122) {
        ch = ch - 97 + 10;
    } else if (ch >= 65 && ch <= 90) {
        ch = ch - 65 + 10;
    } else if (ch == 45) {
        ch = 36;
    } else if (ch == 33) {
        ch = 37;
    } else if (ch == 63) {
        ch = 38;
    } else if (ch == 39) {
        ch = 39;
    } else {
        ch = -1;
    }
    return ch;
}


uint8_t* CondensedFont::getChar(char c) {
    uint8_t index = getCharIndex(c);
    if (index < SquareFontCharCount) {
        return chars[index];
    }
    return NULL;
}


uint8_t CondensedFont::getHeight() {
    return 5;
}


bool CondensedFont::handlesDiacritics() {
    return false;
}


uint8_t CondensedFont::chars[40][5] = {
    { 0x1F, 0x11, 0x11, 0x11, 0x1F }, // 0
    { 0x06, 0x02, 0x02, 0x02, 0x02 }, // 1
    { 0x1F, 0x01, 0x1F, 0x10, 0x1F }, // 2
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    { 0x04, 0x08, 0x00, 0x00, 0x00 }  // ' (single quote)
};